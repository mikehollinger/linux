## drivers/misc/capi/Kconfig
```kconfig
#
# Coherent Accelerator Processor Interface compatible devices
#

config CAPI
	tristate "Support for CAIA compliant accelerators"
	depends on PPC_POWERNV || PPC_PSERIES
	default m
	help
	  Select this option to enable support for adapters that follow the
	  Coherent Accelerator Interface Architecture (CAIA).

config CAPI_PCI
	tristate "Support for CAPI devices via PCI"
	depends on CAPI && PPC_POWERNV
	default y
	help
	  Select this option to support CAPI devices detected via PCI, e.g.
	  when running under Sapphire. This has no effect on CAPI devices
	  detected via the device tree, such as when running under PowerVM.

config CAPI_OF
	tristate "Support for CAPI devices on PowerVM"
	depends on CAPI
	default y
	help
	  Select this option to support CAPI devices detected via the device
	  tree, such as when running under PowerVM.
```

## drivers/misc/cxl/Kconfig
```kconfig
#
# IBM Coherent Accelerator (CXL) compatible devices
#

config CXL_BASE
	bool
	default n
	select PPC_COPRO_BASE

config CXL_KERNEL_API
	bool
	default n

config CXL_EEH
	bool
	default n

config CXL_PCI
	tristate "Support for IBM Coherent Accelerators (CXL) via PCI"
	depends on PPC_POWERNV && PCI_MSI && EEH
	select CXL_BASE
	select CXL_KERNEL_API
	select CXL_EEH
	default m
	help
	  Select this option to enable driver support for IBM Coherent
	  Accelerators (CXL).  CXL is otherwise known as Coherent Accelerator
	  Processor Interface (CAPI).  CAPI allows accelerators in FPGAs to be
	  coherently attached to a CPU via an MMU.  This driver enables
	  userspace programs to access these accelerators via /dev/cxl/afuM.N
	  devices.

	  CAPI adapters are found in POWER8 based systems.
	  This option enables CAPI devices detected via PCI, e.g. when
	  running under OPAL. This has no effect on CXL devices detected
	  via the device tree, such as when running under PowerVM.

	  If unsure, say N.

config CXL_OF
	tristate "Support for IBM Coherent Accelerators (CXL) on PowerVM"
	select CXL_BASE
	default m
	help
	  Select this option to enable driver support for IBM Coherent
	  Accelerators (CXL).  CXL is otherwise known as Coherent Accelerator
	  Processor Interface (CAPI).  CAPI allows accelerators in FPGAs to be
	  coherently attached to a CPU via an MMU.  This driver enables
	  userspace programs to access these accelerators via /dev/cxl/afuM.N
	  devices.

	  CAPI adapters are found in POWER8 based systems.

	  This option enables CAPI devices detected via the device
	  tree, such as when running under PowerVM.
```
